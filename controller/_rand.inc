; Bogus random number table (some mp3...)

str_rand:
	DW H'E3FF'
	DW H'C418'
	DW H'0D00'
	DW H'0228'
	DW H'0988'
	DW H'1042'
	DW H'0800'
	DW H'4E60'
	DW H'830F'
	DW H'50FE'
	DW H'281F'
	DW H'0608'
	DW H'8004'
	DW H'CF81'
	DW H'8313'
	DW H'DFE5'
	DW H'A0FE'
	DW H'A042'
	DW H'E57D'
	DW H'501C'
	DW H'F231'
	DW H'F2E1'
	DW H'C1E7'
	DW H'4300'
	DW H'0C94'
	DW H'F87D'
	DW H'D09C'
	DW H'0820'
	DW H'F07F'
	DW H'FCFF'
	DW H'7FB8'
	DW H'C4FF'
	DW H'8200'
	DW H'4102'
	DW H'B71B'
	DW H'576B'
	DW H'E3FF'
	DW H'C418'
	DW H'0E06'
	DW H'A2B1'
	DW H'C1EC'
	DW H'6885'
	DW H'7100'
	DW H'8A17'
	DW H'10A9'
	DW H'2042'
	DW H'2304'
	DW H'739B'
	DW H'8387'
	DW H'E886'
	DW H'BA31'
	DW H'1D6E'
	DW H'278B'
	DW H'40D1'
	DW H'0D47'
	DW H'12E9'
	DW H'FF2D'
	DW H'ED42'
	DW H'B5E8'
	DW H'FD7F'
	DW H'FFD6'
	DW H'6FA4'
	DW H'EB76'
	DW H'1E35'
	DW H'D6EF'
	DW H'FF9F'
	DW H'FFFF'
	DW H'FFFF'
	DW H'A6FF'
	DW H'0008'
	DW H'184C'
	DW H'9855'
	DW H'E3FF'
	DW H'C418'
	DW H'0E06'
	DW H'32A9'
	DW H'11D4'
	DW H'2888'
	DW H'D300'
	DW H'1F06'
	DW H'8678'
	DW H'CD1E'
	DW H'EF4F'
	DW H'976C'
	DW H'0F6A'
	DW H'547F'
	DW H'1261'
	DW H'0103'
	DW H'5384'
	DW H'81AF'
	DW H'8203'
	DW H'4080'
	DW H'A7E0'
	DW H'3FD1'
	DW H'E2E0'
	DW H'880C'
	DW H'5D28'
	DW H'FF8B'
	DW H'7F2F'
	DW H'E3FF'
	DW H'8205'
	DW H'FFFA'
	DW H'FFFF'
	DW H'FFEB'
	DW H'45FF'
	DW H'0810'
	DW H'5E37'
	DW H'F99E'
	DW H'E3FF'
	DW H'C418'
	DW H'0E06'
	DW H'6A99'
	DW H'29FC'
	DW H'4082'
	DW H'CF00'
	DW H'B6D7'
	DW H'8D52'
	DW H'D5CC'
	DW H'38B9'
	DW H'A052'
	DW H'D8EA'
	DW H'49FE'
	DW H'38AF'
	DW H'075D'
	DW H'B9C0'
	DW H'F861'
	DW H'E38E'
	DW H'D562'
	DW H'90D4'
