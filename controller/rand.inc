; $Id: $

; Random colors table generated by rand.pl

str_rand:
	DW H'0801'
	DW H'0004'
	DW H'0406'
	DW H'0800'
	DW H'0002'
	DW H'0002'
	DW H'0201'
	DW H'0001'
	DW H'0507'
	DW H'0100'
	DW H'0103'
	DW H'0002'
	DW H'0102'
	DW H'0001'
	DW H'0103'
	DW H'0600'
	DW H'0005'
	DW H'0204'
	DW H'0400'
	DW H'0301'
	DW H'0008'
	DW H'0607'
	DW H'0706'
	DW H'0500'
	DW H'0400'
	DW H'0300'
	DW H'0004'
	DW H'0701'
	DW H'0201'
	DW H'0700'
	DW H'0606'
	DW H'0307'
	DW H'0302'
	DW H'0000'
	DW H'0004'
	DW H'0601'
	DW H'0000'
	DW H'0000'
	DW H'0005'
	DW H'0300'
	DW H'0600'
	DW H'0303'
	DW H'0500'
	DW H'0702'
	DW H'0003'
	DW H'0806'
	DW H'0500'
	DW H'0500'
	DW H'0100'
	DW H'0400'
	DW H'0001'
	DW H'0008'
	DW H'0206'
	DW H'0007'
	DW H'0303'
	DW H'0800'
	DW H'0000'
	DW H'0100'
	DW H'0103'
	DW H'0000'
	DW H'0000'
	DW H'0708'
	DW H'0805'
	DW H'0105'
	DW H'0700'
	DW H'0000'
	DW H'0703'
	DW H'0600'
	DW H'0603'
	DW H'0800'
	DW H'0303'
	DW H'0002'
	DW H'0800'
	DW H'0102'
	DW H'0500'
	DW H'0802'
	DW H'0403'
	DW H'0000'
	DW H'0007'
	DW H'0007'
	DW H'0101'
	DW H'0704'
	DW H'0200'
	DW H'0001'
	DW H'0003'
	DW H'0000'
	DW H'0302'
	DW H'0603'
	DW H'0002'
	DW H'0008'
	DW H'0306'
	DW H'0700'
	DW H'0300'
	DW H'0106'
	DW H'0104'
	DW H'0100'
	DW H'0103'
	DW H'0208'
	DW H'0000'
	DW H'0104'
	DW H'0502'
	DW H'0800'
	DW H'0207'
	DW H'0002'
	DW H'0302'
	DW H'0000'
	DW H'0408'
	DW H'0607'
	DW H'0103'
	DW H'0401'
	DW H'0000'
	DW H'0502'
	DW H'0707'
	DW H'0507'
	DW H'0002'
	DW H'0701'
	DW H'0000'
	DW H'0804'
	DW H'0006'
	DW H'0505'
	DW H'0600'
	DW H'0100'
	DW H'0305'
	DW H'0008'
	DW H'0503'
	DW H'0301'
	DW H'0402'
	DW H'0101'

; Total 128 lines
; (256 bytes)
